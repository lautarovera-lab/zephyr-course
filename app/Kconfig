## app/Kconfig
```kconfig
menu "Demo Application"

config APP_BLINKY_ENABLED
	bool "Enable application blinky"

choice APP_LOG_VERBOSITY
	prompt "App log verbosity"
	default APP_LOG_VERBOSITY_INF

config APP_LOG_VERBOSITY_DBG
	bool "Debug"

config APP_LOG_VERBOSITY_INF
	bool "Info"

config APP_LOG_VERBOSITY_WEN
	bool "Warning"

endchoice

endmenu

source "Kconfig.zephyr"
```

## app/Kconfig.heartbeat
```kconfig
menu "Heartbeat LED"

config APP_HEARTBEAT_PERIOD_MS
	int "Heartbeat LED period (ms)"
	default 500
	range 100 2000
	help
	  Sleep duration between heartbeat LED toggles.

endmenu
```

## boards/zephyr_course/zephyr_course_n236/Kconfig
```kconfig
# Copyright 2024-2025 NXP
# SPDX-License-Identifier: Apache-2.0
#
config BOARD_ZEPHYR_COURSE_N236
	select BOARD_EARLY_INIT_HOOK
```

## boards/zephyr_course/zephyr_course_n236/Kconfig.zephyr_course_n236
```kconfig
# Copyright 2024 NXP
# SPDX-License-Identifier: Apache-2.0

config BOARD_ZEPHYR_COURSE_N236
	select SOC_MCXN236
	select SOC_PART_NUMBER_MCXN236VDF
```

## boards/zephyr_course/zephyr_course_n236/board.yml
```yaml
board:
  name: zephyr_course_n236
  full_name: Zephyr Course N236
  vendor: zephyr_course
  socs:
  - name: mcxn236
```

## boards/zephyr_course/zephyr_course_scratch/Kconfig.zephyr_course_scratch
```kconfig
# Copyright (c) 2026 Lautaro Vera
# SPDX-License-Identifier: Apache-2.0

config BOARD_ZEPHYR_COURSE_SCRATCH
	select SOC_MCXN236
	select SOC_PART_NUMBER_MCXN236VDF
```

## boards/zephyr_course/zephyr_course_scratch/board.yml
```yaml
board:
  name: zephyr_course_scratch
  full_name: Zephyr Course Scratch Board
  vendor: zephyr_course
  socs:
  - name: mcxn236
```
